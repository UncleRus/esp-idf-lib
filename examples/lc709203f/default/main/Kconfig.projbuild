## examples/lc709203f/default/main/Kconfig.projbuild
```kconfig
menu "Example configuration"
    config EXAMPLE_I2C_MASTER_SCL
        int "SCL GPIO Number"
        default 5 if IDF_TARGET_ESP8266
        default 6 if IDF_TARGET_ESP32C3
        default 19 if IDF_TARGET_ESP32 || IDF_TARGET_ESP32S2 || IDF_TARGET_ESP32S3
        help
            GPIO number for I2C Master clock line.

    config EXAMPLE_I2C_MASTER_SDA
        int "SDA GPIO Number"
        default 4 if IDF_TARGET_ESP8266
        default 5 if IDF_TARGET_ESP32C3
        default 18 if IDF_TARGET_ESP32 || IDF_TARGET_ESP32S2 || IDF_TARGET_ESP32S3
        help
            GPIO number for I2C Master data line.
    
    config EXAMPLE_I2C_ONBOARD_PULLUP_GPIO_OUTPUT
        int "I2C onboard pullup resistors GPIO output"
        default -1
        help
            Boards like Adafruit Feather esp32s2/s3 have onboard pullup resistors for I2C, 
            which can be enabled (or disabled) by setting output to HIGH (or LOW). 
            Use this option if the board has such feature.

            Set -1 to skip pin configuration.
            Set GPIO number to configure a pin used as onboard pullup resistor output. 
    
    
    choice 
        prompt "I2C onboard pullup resistors GPIO output level" 
        depends on EXAMPLE_I2C_ONBOARD_PULLUP_GPIO_OUTPUT >= 0

        config EXAMPLE_I2C_ONBOARD_PULLUP_GPIO_OUTPUT_HIGH
            bool "HIGH"
        config EXAMPLE_I2C_ONBOARD_PULLUP_GPIO_OUTPUT_LOW
            bool "LOW"
    endchoice

    config EXAMPLE_I2C_ONBOARD_PULLUP_GPIO_OUTPUT_LEVEL
        int
        default 1
        default 1 if EXAMPLE_I2C_ONBOARD_PULLUP_GPIO_OUTPUT_HIGH
        default 0 if EXAMPLE_I2C_ONBOARD_PULLUP_GPIO_OUTPUT_LOW
    
endmenu
```

## examples/led_strip/default/main/Kconfig.projbuild
```kconfig
menu "Example configuration"

config LED_STRIP_LEN
    int "Number of LED pixel"
    default 8
config LED_STRIP_GPIO
    int "GPIO pin number connected to DI"
    default 5
    help
        Choose GPIO number connected to DI (DIN on some products).
endmenu
```

## examples/led_strip/led_effects/main/Kconfig.projbuild
```kconfig
menu "Example configuration"
    config EXAMPLE_LED_GPIO
        int "GPIO number for LEDs"
        default 5
        help
            GPIO number for LEDs.

    config EXAMPLE_LED_MATRIX_WIDTH
        int "the width of the matrix"
        default 16
        help
            The width of LED matrix

    config EXAMPLE_LED_MATRIX_HEIGHT
        int "the height of LED matrix"
        default 16
        help
            The height of LED matrix.

    config EXAMPLE_LED_BRIGHTNESS
        int "brightness of LEDs"
        default 20
        help
            The brightness value of LEDs, between 0 and 255.

    config EXAMPLE_FPS
        int "the number of Frame Per Second"
        default 60

    config EXAMPLE_SWITCH_PERIOD_MS
        int "the delay between effects in millisecond"
        default 5000
endmenu
```

## examples/led_strip/main/Kconfig.projbuild
```kconfig
menu "Example configuration"

config LED_STRIP_LEN
    int "Number of LED pixel"
    default 8
endmenu
```

## examples/led_strip_spi/main/Kconfig.projbuild
```kconfig
menu "Example configuration"
    config EXAMPLE_N_PIXEL
        int "Number of pixels"
        default 8
endmenu
```

## examples/ls7366r/default/main/Kconfig.projbuild
```kconfig
menu "Example configuration"
    config EXAMPLE_PIN_NUM_TEST
        int "GPIO number of test pin"
        default 25
        help
            GPIO number of test pin.

    config EXAMPLE_PIN_NUM_INTR
        int "GPIO number of interrupt pin"
        default 4
        help
            GPIO number of interrupt pin.

    config EXAMPLE_PIN_NUM_MISO
        int "GPIO number of MISO"
        default 12 if IDF_TARGET_ESP8266
        default 19 if IDF_TARGET_ESP32 || IDF_TARGET_ESP32S2 || IDF_TARGET_ESP32S3
        default 4 if IDF_TARGET_ESP32C2 || IDF_TARGET_ESP32C3 || IDF_TARGET_ESP32C5 || IDF_TARGET_ESP32C6 || IDF_TARGET_ESP32C61
        default 4 if IDF_TARGET_ESP32H2
        default 4 if IDF_TARGET_ESP32P4
        help
            GPIO number of MISO

    config EXAMPLE_PIN_NUM_MOSI
        int "GPIO number of MOSI"
        default 13 if IDF_TARGET_ESP8266
        default 23 if IDF_TARGET_ESP32 || IDF_TARGET_ESP32S2 || IDF_TARGET_ESP32S3
        default 5 if IDF_TARGET_ESP32C2 || IDF_TARGET_ESP32C3 || IDF_TARGET_ESP32C5 || IDF_TARGET_ESP32C6 || IDF_TARGET_ESP32C61
        default 5 if IDF_TARGET_ESP32H2
        default 5 if IDF_TARGET_ESP32P4
        help
            GPIO number of MOSI

    config EXAMPLE_PIN_NUM_CLK
        int "GPIO number of CLK"
        default 14 if IDF_TARGET_ESP8266
        default 18 if IDF_TARGET_ESP32 || IDF_TARGET_ESP32S2 || IDF_TARGET_ESP32S3
        default 6 if IDF_TARGET_ESP32C2 || IDF_TARGET_ESP32C3 || IDF_TARGET_ESP32C5 || IDF_TARGET_ESP32C6 || IDF_TARGET_ESP32C61
        default 6 if IDF_TARGET_ESP32H2
        default 6 if IDF_TARGET_ESP32P4
        help
            GPIO number of CLK

    config EXAMPLE_PIN_NUM_CS
        int "GPIO number of CS"
        default 15 if IDF_TARGET_ESP8266
        default 5 if IDF_TARGET_ESP32 || IDF_TARGET_ESP32S2 || IDF_TARGET_ESP32S3 || IDF_TARGET_ESP32C3
        default 7 if IDF_TARGET_ESP32C2 || IDF_TARGET_ESP32C3 || IDF_TARGET_ESP32C5 || IDF_TARGET_ESP32C6 || IDF_TARGET_ESP32C61
        default 7 if IDF_TARGET_ESP32H2
        default 7 if IDF_TARGET_ESP32P4
        help
            GPIO number of CS
endmenu
```

## examples/ls7366r/main/Kconfig.projbuild
```kconfig
menu "Example configuration"
    config EXAMPLE_PIN_NUM_TEST
        int "GPIO number of test pin"
        default 25
        help
            GPIO number of test pin.

    config EXAMPLE_PIN_NUM_INTR
        int "GPIO number of interrupt pin"
        default 4
        help
            GPIO number of interrupt pin.

    config EXAMPLE_PIN_NUM_MISO
        int "GPIO number of MISO"
        default 12 if IDF_TARGET_ESP8266
        default 19 if IDF_TARGET_ESP32 || IDF_TARGET_ESP32S2 || IDF_TARGET_ESP32S3 || IDF_TARGET_ESP32C3
        help
            GPIO number of MISO

    config EXAMPLE_PIN_NUM_MOSI
        int "GPIO number of MOSI"
        default 13 if IDF_TARGET_ESP8266
        default 23 if IDF_TARGET_ESP32 || IDF_TARGET_ESP32S2 || IDF_TARGET_ESP32S3 || IDF_TARGET_ESP32C3
        help
            GPIO number of MOSI

    config EXAMPLE_PIN_NUM_CLK
        int "GPIO number of CLK"
        default 14 if IDF_TARGET_ESP8266
        default 18 if IDF_TARGET_ESP32 || IDF_TARGET_ESP32S2 || IDF_TARGET_ESP32S3 || IDF_TARGET_ESP32C3
        help
            GPIO number of CLK

    config EXAMPLE_PIN_NUM_CS
        int "GPIO number of CS"
        default 15 if IDF_TARGET_ESP8266
        default 5 if IDF_TARGET_ESP32 || IDF_TARGET_ESP32S2 || IDF_TARGET_ESP32S3 || IDF_TARGET_ESP32C3
        help
            GPIO number of CS
endmenu
```

## examples/max31725/default/main/Kconfig.projbuild
```kconfig
menu "Example configuration"

    config EXAMPLE_I2C_ADDR
        hex "I2C address of MAX31725/MAX31726"
        default 0x40
        help
            I2C address of BH1900NUX. The default is `MAX31725_I2C_ADDR_BASE`, or
            0x40. See available options in datasheet.

    choice EXAMPLE_MEASURING_MODE
        prompt "Select measuring mode"
        default EXAMPLE_MEASURING_MODE_TRIGGER
        config EXAMPLE_MEASURING_MODE_TRIGGER
            bool "Trigger measurements"
        config EXAMPLE_MEASURING_MODE_CONTINUOUS
            bool "Continuous  measurements"
    endchoice

    rsource "../../../../devtools/Kconfig.i2c"
endmenu
```

## examples/max31855/default/main/Kconfig.projbuild
```kconfig
menu "Example configuration"

    config EXAMPLE_MISO_GPIO
        int "SPI MISO GPIO Number"
        default 5 if IDF_TARGET_ESP32C2 || IDF_TARGET_ESP32C3 || IDF_TARGET_ESP32C5 || IDF_TARGET_ESP32C6 || IDF_TARGET_ESP32C61
        default 5 if IDF_TARGET_ESP32H2
        default 5 if IDF_TARGET_ESP32P4
        default 19 if IDF_TARGET_ESP32 || IDF_TARGET_ESP32S2 || IDF_TARGET_ESP32S3
        help
            GPIO number for SPI MISO (Master Input / Slave Output) line.

    config EXAMPLE_SCLK_GPIO
        int "SPI SCLK GPIO Number"
        default 6 if IDF_TARGET_ESP32C2 || IDF_TARGET_ESP32C3 || IDF_TARGET_ESP32C5 || IDF_TARGET_ESP32C6 || IDF_TARGET_ESP32C61
        default 6 if IDF_TARGET_ESP32H2
        default 6 if IDF_TARGET_ESP32P4
        default 18 if IDF_TARGET_ESP32 || IDF_TARGET_ESP32S2 || IDF_TARGET_ESP32S3
        help
            GPIO number for SPI SCLK (Clock) line.

    config EXAMPLE_CS_GPIO
        int "SPI CS GPIO Number"
        default 7 if IDF_TARGET_ESP32C2 || IDF_TARGET_ESP32C3 || IDF_TARGET_ESP32C5 || IDF_TARGET_ESP32C6 || IDF_TARGET_ESP32C61
        default 7 if IDF_TARGET_ESP32H2
        default 7 if IDF_TARGET_ESP32P4
        default 5 if IDF_TARGET_ESP32 || IDF_TARGET_ESP32S2 || IDF_TARGET_ESP32S3
    default 6 if IDF_TARGET_ESP32C2 || IDF_TARGET_ESP32C3 || IDF_TARGET_ESP32C5 || IDF_TARGET_ESP32C6 || IDF_TARGET_ESP32C61
        help
            GPIO number for SPI CS (Chip Select) line.

endmenu
```

## examples/max31865/default/main/Kconfig.projbuild
```kconfig
menu "Example configuration"

    choice EXAMPLE_SCALE
        prompt "Select temperature scale standard"
        default EXAMPLE_SCALE_ITS90
        config EXAMPLE_SCALE_ITS90
            bool "ITS-90"
        config EXAMPLE_SCALE_DIN43760
            bool "DIN43760"
        config EXAMPLE_SCALE_US
            bool "US INDUSTRIAL"
    endchoice

    config EXAMPLE_RTD_NOMINAL
        int "RTD nominal, Ohms"
        default 100
        help
        	RTD nominal resistance at 0 deg. C, Ohms (PT100 - 100 Ohms, PT1000 - 1000 Ohms)

    config EXAMPLE_RTD_REF
        int "Reference resistor value, Ohms"
        default 430

    choice EXAMPLE_CONN
        prompt "Select RTD connection type"
        default EXAMPLE_CONN_2WIRE
        config EXAMPLE_CONN_2WIRE
            bool "2 wires"
        config EXAMPLE_CONN_3WIRE
            bool "3 wires"
        config EXAMPLE_CONN_4WIRE
            bool "4 wires"
    endchoice

    choice EXAMPLE_FILTER
        prompt "Select notch frequency for the noise rejection filter"
        default EXAMPLE_FILTER_50
        config EXAMPLE_FILTER_50
            bool "50 Hz"
        config EXAMPLE_FILTER_60
            bool "60 Hz"
    endchoice

    config EXAMPLE_MOSI_GPIO
        int "SPI MOSI GPIO Number"
        default 4 if IDF_TARGET_ESP32C3
        default 23 if IDF_TARGET_ESP32 || IDF_TARGET_ESP32S2 || IDF_TARGET_ESP32S3
        help
            GPIO number for SPI MOSI (Master Output / Slave Input) line.

    config EXAMPLE_MISO_GPIO
        int "SPI MISO GPIO Number"
        default 5 if IDF_TARGET_ESP32C3
        default 19 if IDF_TARGET_ESP32 || IDF_TARGET_ESP32S2 || IDF_TARGET_ESP32S3
        help
            GPIO number for SPI MISO (Master Input / Slave Output) line.

    config EXAMPLE_SCLK_GPIO
        int "SPI SCLK GPIO Number"
        default 6 if IDF_TARGET_ESP32C3
        default 18 if IDF_TARGET_ESP32 || IDF_TARGET_ESP32S2 || IDF_TARGET_ESP32S3
        help
            GPIO number for SPI SCLK (Clock) line.

    config EXAMPLE_CS_GPIO
        int "SPI CS GPIO Number"
        default 7 if IDF_TARGET_ESP32C3
        default 5 if IDF_TARGET_ESP32 || IDF_TARGET_ESP32S2 || IDF_TARGET_ESP32S3
        help
            GPIO number for SPI CS (Chip Select) line.

endmenu
```

## examples/max7219/7seg/main/Kconfig.projbuild
```kconfig
menu "Example configuration"
    config EXAMPLE_DELAY
        int "scrool deley in ms"
        default 2000
        help
            The delay in scrooling.

    config EXAMPLE_PIN_NUM_MOSI
        int "GPIO number of MOSI"
        default 13 if IDF_TARGET_ESP8266
        default 19 if IDF_TARGET_ESP32 || IDF_TARGET_ESP32S2 || IDF_TARGET_ESP32S3 || IDF_TARGET_ESP32C3
        help
            GPIO number of MOSI

    config EXAMPLE_PIN_NUM_CLK
        int "GPIO number of CLK"
        default 14 if IDF_TARGET_ESP8266
        default 18 if IDF_TARGET_ESP32 || IDF_TARGET_ESP32S2 || IDF_TARGET_ESP32S3 || IDF_TARGET_ESP32C3
        help
            GPIO number of CLK

    config EXAMPLE_PIN_NUM_CS
        int "GPIO number of CS"
        default 15 if IDF_TARGET_ESP8266
        default 5 if IDF_TARGET_ESP32 || IDF_TARGET_ESP32S2 || IDF_TARGET_ESP32S3 || IDF_TARGET_ESP32C3
        help
            GPIO number of CS
endmenu
```

## examples/mcp23x17/mcp23017/main/Kconfig.projbuild
```kconfig
menu "Example configuration"
    config EXAMPLE_INTA_GPIO
        int "interrupt GPIO pin number"
        default 19
        help
            GPIO number of external interrupt pin.

    config EXAMPLE_I2C_ADDR
        hex "I2C address of mcp23017"
        default 0x20
        help
            I2C address of `mcp23017`. `mcp23017` has three address pins (`A0`,
            `A1`, and `A2`). The address starts from `0x20` (all pins are
            grounded), which is the default, and ends at `0x27`. See "3.3.1
            ADDRESSING I2C DEVICES (MCP23017)" in the datasheet.

    rsource "../../../../devtools/Kconfig.i2c"
endmenu
```

## examples/mcp23x17/mcp23s17/main/Kconfig.projbuild
```kconfig
menu "Example configuration"

    config EXAMPLE_ADDRESS
        hex "Chip address"
        default 0x20

    config EXAMPLE_MOSI_GPIO
        int "MOSI GPIO number"
        default 13
        help
            MOSI pin GPIO number
        	
    config EXAMPLE_MISO_GPIO
        int "MISO GPIO number"
        default 12
        help
            MISO pin GPIO number

    config EXAMPLE_SCLK_GPIO
        int "SCLK GPIO number"
        default 14
        help
            SCLK pin GPIO number

    config EXAMPLE_CS_GPIO
        int "CS GPIO number"
        default 15
        help
            CS pin GPIO number

    config EXAMPLE_INTA_GPIO
        int "INTA GPIO number"
        default 19
        help
            GPIO number connected to INTA pin

endmenu
```

## examples/mcp342x/default/main/Kconfig.projbuild
```kconfig
menu "Example configuration"
    config EXAMPLE_I2C_ADDR
        hex "I2C address of mcp342x"
        default 0x68
        help
            mcp342x devices have two address pins (`Adr0` and `Adr1`). The I2C
            address starts from `0x68`, which is the default, and ends at `0x6f`.
            See "5.3.2 DEVICE ADDRESS BITS (A2, A1, A0) AND ADDRESS SELECTION PINS
            (MCP3423 AND MCP3424 )" in the datasheet.

    rsource "../../../../devtools/Kconfig.i2c"
endmenu
```

## examples/mcp4725/default/main/Kconfig.projbuild
```kconfig
menu "Example configuration"
    config EXAMPLE_I2C_ADDR
        hex "I2C address of MCP4725"
        default 0x60
        help
            I2C address of MCP4725. The device has three address pins (`A0`,
            `A1`, and `A2`). The addrss start from `0x60`, which is the
            default, and ends at `0x65`.  See "7.2 Device Addressing" in the
            datasheet. See `mcp4725.h` for all possible values.

    rsource "../../../../devtools/Kconfig.i2c"
endmenu
```

## examples/mcp9808/default/main/Kconfig.projbuild
```kconfig
menu "Example configuration"
    config EXAMPLE_I2C_ADDR
        hex "I2C address of mcp9808"
        default 0x18
        help
            MCP9808 has three address pins. The address starts from `0x18`
            (all pins are grouned), which is the default, and ends at  `0x1F`.
            See mcp9808.h for all possible values.

    rsource "../../../../devtools/Kconfig.i2c"
endmenu
```
