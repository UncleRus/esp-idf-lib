## examples/mhz19b/default/main/Kconfig.projbuild
```kconfig
menu "Example configuration"
    config EXAMPLE_UART_TX
        int "UART TX pin number"
        default 15 if IDF_TARGET_ESP8266
        default 18 if IDF_TARGET_ESP32C3
        default 12 if IDF_TARGET_ESP32 || IDF_TARGET_ESP32S2 || IDF_TARGET_ESP32S3
        help
            GPIO number for UART TX line.

    config EXAMPLE_UART_RX
        int "UART RX pin number"
        default 13 if IDF_TARGET_ESP8266
        default 19 if IDF_TARGET_ESP32C3
        default 13 if IDF_TARGET_ESP32 || IDF_TARGET_ESP32S2 || IDF_TARGET_ESP32S3
        help
            GPIO number for UART RX line.
endmenu
```

## examples/mpu6050/default/main/Kconfig.projbuild
```kconfig
menu "MPU6050 Example Configuration"

    choice EXAMPLE_I2C_ADDRESS
        prompt "Select I2C address"
        default EXAMPLE_I2C_ADDRESS_LOW
        help
            Select I2C address

        config EXAMPLE_I2C_ADDRESS_LOW
            bool "MPU6050_I2C_ADDRESS_LOW"
            help
                Choose this when ADDR pin is connected to ground
        config EXAMPLE_I2C_ADDRESS_HIGH
            bool "MPU6050_I2C_ADDRESS_HIGH"
            help
                Choose this when ADDR pin is connected to VCC
    endchoice

    config EXAMPLE_SCL_GPIO
        int "MPU6050 SCL GPIO Number"
        default 5 if IDF_TARGET_ESP8266
        default 6 if IDF_TARGET_ESP32C3
        default 19 if IDF_TARGET_ESP32 || IDF_TARGET_ESP32S2 || IDF_TARGET_ESP32S3
        help
            GPIO number for I2C Master clock line.

    config EXAMPLE_SDA_GPIO
        int "MPU6050 SDA GPIO Number"
        default 4 if IDF_TARGET_ESP8266
        default 5 if IDF_TARGET_ESP32C3
        default 18 if IDF_TARGET_ESP32 || IDF_TARGET_ESP32S2 || IDF_TARGET_ESP32S3
        help
            GPIO number for I2C Master data line.
     
endmenu
```

## examples/mpu6050/main/Kconfig.projbuild
```kconfig
menu "MPU6050 Example Configuration"

    config EXAMPLE_MPU6050_ADDRESS_LOW
	    bool "mpu6050 i2c addr 0x68"
	    default true

    config EXAMPLE_MPU6050_ADDRESS_HIGH
	    bool "mpu6050 i2c addr 0x69"
	    default false

    config EXAMPLE_MPU6050_I2C_MASTER_SCL
        int "MPU6050 SCL GPIO Number"
        default 22 if IDF_TARGET_ESP32 
        help
            GPIO number for I2C Master clock line.

    config EXAMPLE_MPU6050_I2C_MASTER_SDA
        int "MPU6050 SDA GPIO Number"
        default 21 if IDF_TARGET_ESP32 
        help
            GPIO number for I2C Master data line.
     
    config EXAMPLE_MPU6050_I2C_CLOCK_HZ
        int "I2C clock frequency, Hz"
        default 100000
endmenu
```

## examples/ms5611/default/main/Kconfig.projbuild
```kconfig
menu "Example configuration"
    choice EXAMPLE_I2C_ADDRESS
        prompt "Select I2C address"
        default EXAMPLE_I2C_ADDRESS_LO
        help
            Select I2C address

        config EXAMPLE_I2C_ADDRESS_HIGH
            bool "MS5611_ADDR_CSB_HIGH"
            help
                Choose this when CSB pin is high.
        config EXAMPLE_I2C_ADDRESS_LOW
            bool "MS5611_ADDR_CSB_LOW"
            help
                Choose this when CSB pin is low.
    endchoice

    rsource "../../../../devtools/Kconfig.i2c"
endmenu
```

## examples/pca9557/default/main/Kconfig.projbuild
```kconfig
menu "Example configuration"
    config EXAMPLE_I2C_ADDR
        hex "I2C address of the device"
        default 0x18
        help
            I2C address of the device.

            PCA9557 has three address pins (`A0`, `A1` and `A2`). The address
            starts from `0x18` (all address pins are grounded), which is the
            default. See "8.3.2.1 Device Address" in the datasheet.

            PCA9537 has a fixed I2C address (`0x49`).

            TCA9534 has three address pins (`A0`, `A1` and `A2`). The address
            starts from `0x20` (all address pins are grounded)

    rsource "../../../../devtools/Kconfig.i2c"
endmenu
```

## examples/pca9685/default/main/Kconfig.projbuild
```kconfig
menu "Example configuration"
    config EXAMPLE_PWM_FREQ_HZ
        int "Frequency of PWM outputs"
        default 1500
        help
            Frequency of PWM outputs. The maximum PWM frequency is 1526 Hz,
            and the minimum PWM frequency is 24 Hz. See "7.3.5 PWM frequency
            PRE_SCALE" in the datasheet.
    rsource "../../../../devtools/Kconfig.i2c"
endmenu
```

## examples/pca9685/main/Kconfig.projbuild
```kconfig
menu "Example configuration"
    config EXAMPLE_PWM_FREQ_HZ
        int "Frequency of PWM outputs"
        default 1500
        help
            Frequency of PWM outputs. The maximum PWM frequency is 1526 Hz,
            and the minimum PWM frequency is 24 Hz. See "7.3.5 PWM frequency
            PRE_SCALE" in the datasheet.

    config EXAMPLE_I2C_MASTER_SCL
        int "SCL GPIO Number"
        default 5 if IDF_TARGET_ESP8266
        default 6 if IDF_TARGET_ESP32C3
        default 19 if IDF_TARGET_ESP32 || IDF_TARGET_ESP32S2 || IDF_TARGET_ESP32S3
        help
            GPIO number for I2C Master clock line.

    config EXAMPLE_I2C_MASTER_SDA
        int "SDA GPIO Number"
        default 4 if IDF_TARGET_ESP8266
        default 5 if IDF_TARGET_ESP32C3
        default 18 if IDF_TARGET_ESP32 || IDF_TARGET_ESP32S2 || IDF_TARGET_ESP32S3
        help
            GPIO number for I2C Master data line.
endmenu
```
