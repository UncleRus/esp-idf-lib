## examples/ultrasonic/default/main/Kconfig.projbuild
```kconfig
menu "Example configuration"

    config EXAMPLE_TRIGGER_GPIO
        int "Trigger GPIO number"
        default 4 if IDF_TARGET_ESP8266
        default 4 if IDF_TARGET_ESP32C2 || IDF_TARGET_ESP32C3 || IDF_TARGET_ESP32C5 || IDF_TARGET_ESP32C6 || IDF_TARGET_ESP32C61
        default 4 if IDF_TARGET_ESP32H2
        default 4 if IDF_TARGET_ESP32P4
        default 17 if IDF_TARGET_ESP32 || IDF_TARGET_ESP32S2 || IDF_TARGET_ESP32S3
        help
            GPIO number for TRIGGER pin of ultrasonic module

    config EXAMPLE_ECHO_GPIO
        int "Echo GPIO number"
        default 5 if IDF_TARGET_ESP8266 || IDF_TARGET_ESP32C3
        default 5 if IDF_TARGET_ESP32C2 || IDF_TARGET_ESP32C3 || IDF_TARGET_ESP32C5 || IDF_TARGET_ESP32C6 || IDF_TARGET_ESP32C61
        default 5 if IDF_TARGET_ESP32H2
        default 5 if IDF_TARGET_ESP32P4
        default 16 if IDF_TARGET_ESP32 || IDF_TARGET_ESP32S2 || IDF_TARGET_ESP32S3
        help
            GPIO number for ECHO pin of ultrasonic module

    config EXAMPLE_MAX_DISTANCE
    	int "Maximal distance, cm"
    	default 500
    	help
    	    Maximum measurable distance. If the distance is greater than this parameter, there will be a timeout

endmenu
```

## examples/veml7700/default/main/Kconfig.projbuild
```kconfig
menu "Example Configuration"

    config EXAMPLE_SCL_GPIO_NUM
        int "SCL GPIO Num"
        default 5 if IDF_TARGET_ESP8266
        default 6 if IDF_TARGET_ESP32C3 || IDF_TARGET_ESP32C2 || IDF_TARGET_ESP32H2
        default 19 if IDF_TARGET_ESP32 || IDF_TARGET_ESP32S2 || IDF_TARGET_ESP32S3
        help
            GPIO number for I2C Master clock line.

    config EXAMPLE_SDA_GPIO_NUM
        int "SDA GPIO Num"
        default 4 if IDF_TARGET_ESP8266
        default 5 if IDF_TARGET_ESP32C3 || IDF_TARGET_ESP32C2 || IDF_TARGET_ESP32H2
        default 18 if IDF_TARGET_ESP32 || IDF_TARGET_ESP32S2 || IDF_TARGET_ESP32S3
        help
            GPIO number for I2C Master data line.

    config EXAMPLE_SCL_PULLUP_ENABLE
        bool "SCL pullup enable"
        default n
        help
            Enable internal pullup resistor for SCL.

    config EXAMPLE_SDA_PULLUP_ENABLE
        bool "SDA pullup enable"
        default n
        help
            Enable internal pullup resistor for SDA.

endmenu
```

## examples/wiegand/default/main/Kconfig.projbuild
```kconfig
menu "Example configuration"

    config EXAMPLE_D0_GPIO
        int "D0 GPIO number"
        default 4 if IDF_TARGET_ESP8266
        default 4 if IDF_TARGET_ESP32C2 || IDF_TARGET_ESP32C3 || IDF_TARGET_ESP32C5 || IDF_TARGET_ESP32C6 || IDF_TARGET_ESP32C61
        default 4 if IDF_TARGET_ESP32H2
        default 4 if IDF_TARGET_ESP32P4
        default 16 if IDF_TARGET_ESP32 || IDF_TARGET_ESP32S2 || IDF_TARGET_ESP32S3
        help
            GPIO number for D0 Wiegand line

    config EXAMPLE_D1_GPIO
        int "D1 GPIO number"
        default 5 if IDF_TARGET_ESP8266
        default 5 if IDF_TARGET_ESP32C2 || IDF_TARGET_ESP32C3 || IDF_TARGET_ESP32C5 || IDF_TARGET_ESP32C6 || IDF_TARGET_ESP32C61
        default 5 if IDF_TARGET_ESP32H2
        default 5 if IDF_TARGET_ESP32P4
        default 17 if IDF_TARGET_ESP32 || IDF_TARGET_ESP32S2 || IDF_TARGET_ESP32S3
        help
            GPIO number for D1 Wiegand line

    config EXAMPLE_BUF_SIZE
        int "Buffer size, bytes"
        default 4
        help
            Buffer size for Wiegand data. 4 bytes should be enough for demo

endmenu
```
