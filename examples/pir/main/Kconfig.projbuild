## examples/tsl2561/default/main/Kconfig.projbuild
```kconfig
menu "Example configuration"

    config EXAMPLE_I2C_ADDR
        hex "I2C address of TSL2561"
        default 0x39
        help
            I2C address of TSL2561. The default is `TSL2561_I2C_ADDR_FLOAT`, or
            0x39. See available options in datasheet.

    rsource "../../../../devtools/Kconfig.i2c"
endmenu
```

## examples/tsl2591/interrupt/main/Kconfig.projbuild
```kconfig
menu "Example configuration"
    config EXAMPLE_INTR_GPIO
        int "INTR GPIO Number"
        default 14 if IDF_TARGET_ESP8266
        default 7 if IDF_TARGET_ESP32C2 || IDF_TARGET_ESP32C3 || IDF_TARGET_ESP32C5 || IDF_TARGET_ESP32C6 || IDF_TARGET_ESP32C61
        default 5 if IDF_TARGET_ESP32 || IDF_TARGET_ESP32S2 || IDF_TARGET_ESP32S3
        default 5 if IDF_TARGET_ESP32H2
        default 5 if IDF_TARGET_ESP32P4
        help
            GPIO number connected to INTR pin.

    rsource "../../../../devtools/Kconfig.i2c"
endmenu
```

## examples/tsys01/default/main/Kconfig.projbuild
```kconfig
menu "Example configuration"
    choice EXAMPLE_I2C_ADDRESS
        prompt "Select I2C address of TSYS01"
        default EXAMPLE_I2C_ADDRESS1
        help
            Select I2C address
        config EXAMPLE_I2C_ADDRESS1
            bool "TSYS01_I2C_ADDR1 (0x76)"
        config EXAMPLE_I2C_ADDRESS2
            bool "TSYS01_I2C_ADDR2 (0x77)"
    endchoice

    rsource "../../../../devtools/Kconfig.i2c"
endmenu
```
