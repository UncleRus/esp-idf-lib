## examples/pir/main/Kconfig.projbuild
```kconfig
menu "MY PROJECT configuration"

##
## LED On-devboard
choice MY_LED_ON_DEVBOARD_GPIO_NUM
    prompt "On-devboard LED GPIO#"
    default MY_LED_ON_DEVBOARD_GPIO_NUM_HUZZAH32_13
    help
        The on-devboard LED GPIO# to be used.
config MY_LED_ON_DEVBOARD_GPIO_NUM_HUZZAH32_13
    bool "HUZZAH32 GPIO#13"
config MY_LED_ON_DEVBOARD_GPIO_NUM_LOLIN32LITE_22
    bool "LOLIN32LITE GPIO#22"
config MY_LED_ON_DEVBOARD_GPIO_NUM_LOLIND32_5
    bool "LOLIND32 GPIO#5"
config MY_LED_ON_DEVBOARD_GPIO_NUM_NODEMCU
    bool "NodeMCU GPIO#2 (D4)"
config MY_LED_ON_DEVBOARD_GPIO_NUM_OTHER
    bool "Other GPIO#"
endchoice
config MY_LED_ON_DEVBOARD_GPIO_NUM_OTHER_VAL
    int "Other on-devboard LED GPIO#" if MY_LED_ON_DEVBOARD_GPIO_NUM_OTHER
    default 99
config MY_LED_ON_DEVBOARD_GPIO_NUM
    int
    default 13 if MY_LED_ON_DEVBOARD_GPIO_NUM_HUZZAH32_13
    default 22 if MY_LED_ON_DEVBOARD_GPIO_NUM_LOLIN32LITE_22
    default  5 if MY_LED_ON_DEVBOARD_GPIO_NUM_LOLIND32_5
    default  2 if MY_LED_ON_DEVBOARD_GPIO_NUM_NODEMCU
    default MY_LED_ON_DEVBOARD_GPIO_NUM_OTHER_VAL if MY_LED_ON_DEVBOARD_GPIO_NUM_OTHER

choice MY_LED_ON_DEVBOARD_WIRING_TYPE
    prompt "LED on-board wiring type"
    default MY_LED_ON_DEVBOARD_WIRING_TYPE_LED_LOW_SIDE
    help
        The LED on-board wiring type to be used.
config MY_LED_ON_DEVBOARD_WIRING_TYPE_LED_LOW_SIDE
    bool "LED_LOW_SIDE (HUZZAH32, NodeMCU)"
config MY_LED_ON_DEVBOARD_WIRING_TYPE_LED_HIGH_SIDE
    bool "LED_HIGH_SIDE (LOLIN32LITE, LOLIND32)"
endchoice
config MY_LED_ON_DEVBOARD_WIRING_TYPE
    int
    default 1 if MY_LED_ON_DEVBOARD_WIRING_TYPE_LED_LOW_SIDE
    default 2 if MY_LED_ON_DEVBOARD_WIRING_TYPE_LED_HIGH_SIDE

config MY_SENSOR_DATA_GPIO_NUM
    int "MY_SENSOR_DATA_GPIO_NUM (Huzzah32 #14 bottomright-2)(LOLIN D32 #13 bottomleft-3 NodeMCU #5 D1)"
	default 14

endmenu
```

## examples/qmi8658c/default/main/Kconfig.projbuild
```kconfig
menu "Example configuration"
    config EXAMPLE_QMI_ADDRESS
        hex "I2C address of QMI8658C"
        default 0x6B
        help
            I2C address of QMI8658C IMU.
            This address is used to communicate with the IMU over I2C.
            The default value is 0x6B, which is the common address for this device.
    rsource "../../../../devtools/Kconfig.i2c"
endmenu
```

## examples/qmi8658c/default/sdkconfig.defaults
```kconfig
# add required non-default option for the example if any
CONFIG_EXAMPLE_I2C_MASTER_SCL=22
CONFIG_EXAMPLE_I2C_MASTER_SDA=21
```

## examples/qmp6988/default/main/Kconfig.projbuild
```kconfig
menu "Example configuration"
    choice EXAMPLE_QMP6988_DEMO
        prompt "Demo mode"
        default EXAMPLE_QMP6988_DEMO_NORMAL
        help
            Choose how to masure values from the sensor. See the main.c for
            details.

        config EXAMPLE_QMP6988_DEMO_FORCED
            bool "Forced mode"
            help
                In this example the qmp6988 makes a single measurement before entering
                sleep mode again.

        config EXAMPLE_QMP6988_DEMO_NORMAL
            bool "Normal mode"
            help
                In this example the qmp6988 makes continuous measurements.

    endchoice

    config EXAMPLE_QMP6988_ADDR
        hex "I2C address of QMP6988"
        default 0x70
        help
            I2C address of QMP6988, default 0x70.

    rsource "../../../../devtools/Kconfig.i2c"
endmenu
```

## examples/scd30/default/main/Kconfig.projbuild
```kconfig
menu "Example configuration"
    rsource "../../../../devtools/Kconfig.i2c"
endmenu
```

## examples/sgm58031/default/main/Kconfig.projbuild
```kconfig
menu "Example configuration"
    config EXAMPLE_DEV_COUNT
        int "Number of SGM58031"
        default 2
        help
            Number of SGM58031 devices on the bus.

    rsource "../../../../devtools/Kconfig.i2c"
endmenu
```

## examples/sgm58031/single-shot/main/Kconfig.projbuild
```kconfig
menu "Example configuration"
    choice EXAMPLE_I2C_DEVICE_ADDRESS
        bool "SGM58031 I2C address"
        default SGM58031_0x48_ADDR
        help
            Select SMG58031 I2C address

        config SGM58031_0x48_ADDR
            bool "0x49 (ADDR <-> GND)"
        config SGM58031_0x49_ADDR
            bool "0x49 (ADDR <-> VDD)"
        config SGM58031_0x4A_ADDR
            bool "0x4A (ADDR <-> SDA)"
        config SGM58031_0x48_ADDR
            bool "0x4B (ADDR <-> SCL)"
    endchoice

    config EXAMPLE_I2C_DEVICE_ADDRESS
        hex
        default 0x48 if SGM58031_0x48_ADDR
        default 0x49 if SGM58031_0x49_ADDR
        default 0x4A if SGM58031_0x4A_ADDR
        default 0x4B if SGM58031_0x4B_ADDR

    rsource "../../../../devtools/Kconfig.i2c"
endmenu
```

## examples/sgp40/default/main/Kconfig.projbuild
```kconfig
menu "Example configuration"
    config EXAMPLE_SHT3X_ADDR
        hex "I2C address of SHT3x"
        default 0x44
        help
            I2C address of SHT3x, either 0x44 or 0x45. When ADDR pin is
            grounded, choose 0x44. When ADDR pin is pulled up to VDD, choose
            0x45.

    rsource "../../../../devtools/Kconfig.i2c"
endmenu
```

## examples/sht3x/default/main/Kconfig.projbuild
```kconfig
menu "Example configuration"
    choice EXAMPLE_SHT3X_DEMO
        prompt "Demo mode"
        default EXAMPLE_SHT3X_DEMO_HL
        help
            Choose how to masure values from the sensor. See the main.c for
            details.

        config EXAMPLE_SHT3X_DEMO_HL
            bool "High level"
            help
                In this example it uses the high level function
                sht3x_measure() to perform one measurement in each cycle.

        config EXAMPLE_SHT3X_DEMO_LL
            bool "Low level"
            help
                In this example it starts the measurement, waits for the
                results and fetches the results using separate functions

    endchoice

    config EXAMPLE_SHT3X_ADDR
        hex "I2C address of SHT3x"
        default 0x44
        help
            I2C address of SHT3x, either 0x44 or 0x45. When ADDR pin is
            grounded, choose 0x44. When ADDR pin is pulled up to VDD, choose
            0x45.
    rsource "../../../../devtools/Kconfig.i2c"
endmenu
```

## examples/sht3x/main/Kconfig
```kconfig
menu "SHT3X demo"

	choice
		prompt "Demo mode"
		config SHT3X_DEMO_SSHL
			bool "Single shot high level"
		config SHT3X_DEMO_SSLL
			bool "Single shot low level"
		config SHT3X_DEMO_PERIODIC
			bool "Periodic"
	endchoice
    
endmenu
```

## examples/sht4x/default/main/Kconfig.projbuild
```kconfig
menu "Example configuration"
    choice EXAMPLE_SHT4X_DEMO
        prompt "Demo mode"
        default EXAMPLE_SHT4X_DEMO_HL
        help
            Choose how to masure values from the sensor. See the main.c for
            details.

        config EXAMPLE_SHT4X_DEMO_HL
            bool "High level"
            help
                User task that triggers a measurement every 5 seconds.
                In this example it uses the high level function *sht4x_measure*
                to perform one measurement in each cycle.

        config EXAMPLE_SHT4X_DEMO_LL
            bool "Low level"
            help
                User task that triggers a measurement every 5 seconds.  In this
                example it starts the measurement, waits for the results and
                fetches the results using separate functions

    endchoice

    rsource "../../../../devtools/Kconfig.i2c"
endmenu
```

## examples/sht4x/main/Kconfig
```kconfig
menu "SHT4X demo"

	choice
		prompt "Demo mode"
		config SHT4X_DEMO_HL
			bool "High level"
		config SHT4X_DEMO_LL
			bool "Low level"
	endchoice
    
endmenu
```

## examples/sht4x/main/Kconfig.projbuild
```kconfig
menu "Example configuration"
    choice EXAMPLE_SHT4X_DEMO
        prompt "Demo mode"
        default EXAMPLE_SHT4X_DEMO_HL
        help
            Choose how to masure values from the sensor. See the main.c for
            details.

        config EXAMPLE_SHT4X_DEMO_HL
            bool "High level"
            help
                User task that triggers a measurement every 5 seconds.
                In this example it uses the high level function *sht4x_measure*
                to perform one measurement in each cycle.

        config EXAMPLE_SHT4X_DEMO_LL
            bool "Low level"
            help
                User task that triggers a measurement every 5 seconds.  In this
                example it starts the measurement, waits for the results and
                fetches the results using separate functions

    endchoice

    config EXAMPLE_I2C_MASTER_SCL
        int "SCL GPIO Number"
        default 5 if IDF_TARGET_ESP8266
        default 6 if IDF_TARGET_ESP32C3
        default 19 if IDF_TARGET_ESP32 || IDF_TARGET_ESP32S2 || IDF_TARGET_ESP32S3
        help
            GPIO number for I2C Master clock line.

    config EXAMPLE_I2C_MASTER_SDA
        int "SDA GPIO Number"
        default 4 if IDF_TARGET_ESP8266
        default 5 if IDF_TARGET_ESP32C3
        default 18 if IDF_TARGET_ESP32 || IDF_TARGET_ESP32S2 || IDF_TARGET_ESP32S3
        help
            GPIO number for I2C Master data line.
endmenu
```

## examples/si7021/default/main/Kconfig.projbuild
```kconfig
menu "Example configuration"
    choice EXAMPLE_CHIP_TYPE
        prompt "Select chip type"
        default EXAMPLE_CHIP_TYPE_SI70xx
        help
            Select chip type.

        config EXAMPLE_CHIP_TYPE_SI70xx
            bool "SI70xx"
            help
                Choose this when the chip is one of SI70xx family.
        config EXAMPLE_CHIP_TYPE_SHT2x_HTU21D
            bool "SHT2x or HTU21D"
            help
                Choose this when the chip is either SHT2x or HTU21D.
    endchoice

    rsource "../../../../devtools/Kconfig.i2c"
endmenu
```

## examples/sts3x/default/main/Kconfig.projbuild
```kconfig
menu "Example configuration"
    choice EXAMPLE_STS3X_DEMO
        prompt "Demo mode"
        default EXAMPLE_STS3X_DEMO_HL
        help
            Choose how to masure values from the sensor. See the main.c for
            details.

        config EXAMPLE_STS3X_DEMO_HL
            bool "High level"
            help
                In this example it uses the high level function
                sts3x_measure() to perform one measurement in each cycle.

        config EXAMPLE_STS3X_DEMO_LL
            bool "Low level"
            help
                In this example it starts the measurement, waits for the
                results and fetches the results using separate functions

    endchoice

    config EXAMPLE_STS3X_ADDR
        hex "I2C address of STS3x"
        default 0x44
        help
            I2C address of STS3x, either 0x44 or 0x45. When ADDR pin is
            grounded, choose 0x44. When ADDR pin is pulled up to VDD, choose
            0x45.

    rsource "../../../../devtools/Kconfig.i2c"
endmenu
```

## examples/tca6424a/default/main/Kconfig.projbuild
```kconfig
menu "Example configuration"
    choice EXAMPLE_I2C_ADDRESS
        prompt "Select I2C address"
        default EXAMPLE_I2C_ADDRESS_GND
        help
            Select I2C address

        config EXAMPLE_I2C_ADDRESS_GND
            bool "TCA6424A_I2C_ADDRESS_GND"
            help
                Choose this when ADDR pin is connected to ground
        config EXAMPLE_I2C_ADDRESS_VCC
            bool "TCA6424A_I2C_ADDRESS_VCC"
            help
                Choose this when ADDR pin is connected to VCC
    endchoice
    
    config EXAMPLE_INT_GPIO
        int "INT GPIO Number"
        default 14 if IDF_TARGET_ESP8266
        default 7 if IDF_TARGET_ESP32C3
        default 5 if IDF_TARGET_ESP32 || IDF_TARGET_ESP32S2 || IDF_TARGET_ESP32S3
        help
            GPIO number connected to INT pin.

    config EXAMPLE_I2C_MASTER_SCL
        int "SCL GPIO Number"
        default 5 if IDF_TARGET_ESP8266
        default 6 if IDF_TARGET_ESP32C3
        default 19 if IDF_TARGET_ESP32 || IDF_TARGET_ESP32S2 || IDF_TARGET_ESP32S3
        help
            GPIO number for I2C Master clock line.

    config EXAMPLE_I2C_MASTER_SDA
        int "SDA GPIO Number"
        default 4 if IDF_TARGET_ESP8266
        default 5 if IDF_TARGET_ESP32C3
        default 18 if IDF_TARGET_ESP32 || IDF_TARGET_ESP32S2 || IDF_TARGET_ESP32S3
        help
            GPIO number for I2C Master data line.
endmenu
```

## examples/tca9548/default/main/Kconfig.projbuild
```kconfig
menu "Example configuration"
    config EXAMPLE_SWITCH_ADDR
        hex "I2C address of TCA9548"
        default 0x70

    rsource "../../../../devtools/Kconfig.i2c"
endmenu
```

## examples/tca95x5/default/main/Kconfig.projbuild
```kconfig
menu "Example configuration"

	config EXAMPLE_I2C_ADDR
		hex "I2C address of TCA9555"
		default 0x20
		help
			I2C address of TCA9555. The default is `TCA95X5_I2C_ADDR_BASE`, or
			0x20. See available options in datasheet.

    config EXAMPLE_INT_GPIO
        int "INT GPIO Number"
        default 14 if IDF_TARGET_ESP8266
        default 7 if IDF_TARGET_ESP32C2 || IDF_TARGET_ESP32C3 || IDF_TARGET_ESP32C5 || IDF_TARGET_ESP32C6 || IDF_TARGET_ESP32C61
        default 5 if IDF_TARGET_ESP32 || IDF_TARGET_ESP32S2 || IDF_TARGET_ESP32S3
        default 5 if IDF_TARGET_ESP32H2
        help
            GPIO number connected to INT pin.

    rsource "../../../../devtools/Kconfig.i2c"
endmenu
```

## examples/tca95x5/main/Kconfig.projbuild
```kconfig
menu "Example configuration"

	config EXAMPLE_I2C_ADDR
		hex "I2C address of TCA9555"
		default 0x20
		help
			I2C address of TCA9555. The default is `TCA95X5_I2C_ADDR_BASE`, or
			0x20. See available options in datasheet.

    config EXAMPLE_I2C_MASTER_SCL
        int "SCL GPIO Number"
        default 5 if IDF_TARGET_ESP8266
        default 6 if IDF_TARGET_ESP32C3
        default 19 if IDF_TARGET_ESP32 || IDF_TARGET_ESP32S2 || IDF_TARGET_ESP32S3
        help
            GPIO number for I2C Master clock line.

    config EXAMPLE_I2C_MASTER_SDA
        int "SDA GPIO Number"
        default 4 if IDF_TARGET_ESP8266
        default 5 if IDF_TARGET_ESP32C3
        default 18 if IDF_TARGET_ESP32 || IDF_TARGET_ESP32S2 || IDF_TARGET_ESP32S3
        help
            GPIO number for I2C Master data line.

    config EXAMPLE_INT_GPIO
        int "INT GPIO Number"
        default 14 if IDF_TARGET_ESP8266
        default 7 if IDF_TARGET_ESP32C3
        default 5 if IDF_TARGET_ESP32 || IDF_TARGET_ESP32S2 || IDF_TARGET_ESP32S3
        help
            GPIO number connected to INT pin.

endmenu
```

## examples/tda74xx/default/main/Kconfig.projbuild
```kconfig
menu "Example configuration"

    config EXAMPLE_USING_MIDDLE_RANGE_CONTROL
        bool "Use middle-range control"
        default true
        help
            Use middle-range control in the example. TDA7439DS supports
            middle-range control, TDA7440 does not. Select this if the chip
            supports middle-range control.

    config EXAMPLE_INPUT_CHANNEL
        int "Input channel to use, from 0 to 3"
        default 0
        help
            Input gain in dB at 2dB step.

    config EXAMPLE_INPUT_GAIN
        int "Input gain, from 0 to 30"
        default 28
        help
            Input gain in dB at 2dB step.

    config EXAMPLE_VOLUME
        int "The volume control in dB, from -48 to 0"
        default 0
        help
            The volume control in dB at 1dB step.

    config EXAMPLE_BASS
        int "Bass control in dB, from -14 to 14"
        default 0
        help
            Bass control in dB at 2dB step.

    config EXAMPLE_MIDDLE
        int "Middle-range control in dB, from -14 to 14"
        default 0
        help
            Middle-range control in dB at 2dB step.
        depends on EXAMPLE_USING_MIDDLE_RANGE_CONTROL

    config EXAMPLE_TREBLE
        int "Treble control in dB, from -14 to 14"
        default 0
        help
            Treble control in dB at 2dB step.

    rsource "../../../../devtools/Kconfig.i2c"
endmenu
```
