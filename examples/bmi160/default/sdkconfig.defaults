## examples/button/default/main/Kconfig.projbuild
```kconfig
menu "Example configuration"

    config EXAMPLE_BUTTON1_GPIO
        int "Button 1 GPIO number"
        default 14 if IDF_TARGET_ESP8266
        default 6 if IDF_TARGET_ESP32C2 || IDF_TARGET_ESP32C3 || IDF_TARGET_ESP32C5 || IDF_TARGET_ESP32C6 || IDF_TARGET_ESP32C61
        default 16 if IDF_TARGET_ESP32 || IDF_TARGET_ESP32S2 || IDF_TARGET_ESP32S3
        default 4 if IDF_TARGET_ESP32H2
        help
            GPIO number for the first button

    config EXAMPLE_BUTTON2_GPIO
        int "Button 2 GPIO number"
        default 12 if IDF_TARGET_ESP8266
        default 5 if IDF_TARGET_ESP32C2 || IDF_TARGET_ESP32C3 || IDF_TARGET_ESP32C5 || IDF_TARGET_ESP32C6 || IDF_TARGET_ESP32C61
        default 17 if IDF_TARGET_ESP32 || IDF_TARGET_ESP32S2 || IDF_TARGET_ESP32S3
        default 3 if IDF_TARGET_ESP32H2
        help
            GPIO number for the second button

endmenu
```

## examples/dht/default/main/Kconfig.projbuild
```kconfig
menu "Example configuration"
    choice EXAMPLE_CHIP_TYPE
        prompt "Select chip type"
        default EXAMPLE_TYPE_AM2301

        config EXAMPLE_TYPE_DHT11
            bool "DHT11"
        config EXAMPLE_TYPE_AM2301
            bool "DHT21/DHT22/AM2301/AM2302/AM2321"
        config EXAMPLE_TYPE_SI7021
            bool "Itead Si7021"
    endchoice

    config EXAMPLE_DATA_GPIO
        int "Data GPIO number"
        default 4 if IDF_TARGET_ESP8266 || IDF_TARGET_ESP32C3
        default 17 if IDF_TARGET_ESP32 || IDF_TARGET_ESP32S2 || IDF_TARGET_ESP32S3
        help
            GPIO number connected to DATA pin

    config EXAMPLE_INTERNAL_PULLUP
        bool "Enable internal pull-up resistor"
        default 0
        help
        	Check this option if you don't have external pull-up resistor on data GPIO.
        	DHT sensors that come mounted on a PCB generally have pull-up resistors on the data pin.
        	But for stable operation, it is recommended to provide an external pull-up resistor.
        	
endmenu
```

## examples/dps310/altitude/main/Kconfig.projbuild
```kconfig
menu "Example configuration"
    config EXAMPLE_I2C_ADDRESS
        hex "I2C address"
        default 0x77
        help
            I2C address of DPS310. When SDO is pulled low, 0x76. When pulled high, 0x77.
    config EXAMPLE_REAL_ALTITUDE
        int "Real altitude of the device in meter"
        default 16
        help
            Change this to the altitude of the device.
    rsource "../../../../devtools/Kconfig.i2c"
endmenu
```

## examples/dps310/default/main/Kconfig.projbuild
```kconfig
menu "Example configuration"
    config EXAMPLE_I2C_ADDRESS
        hex "I2C address"
        default 0x77
        help
            I2C address of DPS310. When SDO is pulled low, 0x76. When pulled high, 0x77.

    rsource "../../../../devtools/Kconfig.i2c"
endmenu
```

## examples/ds1302/default/main/Kconfig.projbuild
```kconfig
menu "Example configuration"

    config EXAMPLE_CE_GPIO
        int "CE GPIO number"
        default 5 if IDF_TARGET_ESP8266
        default 5 if IDF_TARGET_ESP32C2 || IDF_TARGET_ESP32C3 || IDF_TARGET_ESP32C5 || IDF_TARGET_ESP32C6 || IDF_TARGET_ESP32C61
        default 5 if IDF_TARGET_ESP32H2
        default 5 if IDF_TARGET_ESP32P4
        default 16 if IDF_TARGET_ESP32 || IDF_TARGET_ESP32S2 || IDF_TARGET_ESP32S3
        help
            GPIO connected to CE pin

    config EXAMPLE_IO_GPIO
        int "I/O GPIO number"
        default 4 if IDF_TARGET_ESP8266
        default 4 if IDF_TARGET_ESP32C2 || IDF_TARGET_ESP32C3 || IDF_TARGET_ESP32C5 || IDF_TARGET_ESP32C6 || IDF_TARGET_ESP32C61
        default 4 if IDF_TARGET_ESP32H2
        default 4 if IDF_TARGET_ESP32P4
        default 17 if IDF_TARGET_ESP32 || IDF_TARGET_ESP32S2 || IDF_TARGET_ESP32S3
        help
            GPIO connected to I/O pin

    config EXAMPLE_SCLK_GPIO
        int "SCLK GPIO number"
        default 0 if IDF_TARGET_ESP8266
        default 6 if IDF_TARGET_ESP32C2 || IDF_TARGET_ESP32C3 || IDF_TARGET_ESP32C5 || IDF_TARGET_ESP32C6 || IDF_TARGET_ESP32C61
        default 6 if IDF_TARGET_ESP32H2
        default 6 if IDF_TARGET_ESP32P4
        default 18 if IDF_TARGET_ESP32 || IDF_TARGET_ESP32S2 || IDF_TARGET_ESP32S3
        help
            GPIO connected to SCLK pin

endmenu
```

## examples/ds18x20/multi/main/Kconfig.projbuild
```kconfig
menu "Example configuration"
    config EXAMPLE_ONEWIRE_GPIO
        int "GPIO Number of 1-Wire bus, or DQ"
        default 4 if IDF_TARGET_ESP8266
        default 18 if IDF_TARGET_ESP32C3
        default 17 if IDF_TARGET_ESP32 || IDF_TARGET_ESP32S2 || IDF_TARGET_ESP32S3
        help
            GPIO Number of 1-Wire bus, or DQ. You might need an external
            pullup resistor on the bus. See README.md for details.

    config EXAMPLE_DS18X20_MAX_SENSORS
        int "Number of ds18x20 sensors on the 1-Wire bus"
        default 8
        help
            Max number of ds18x20 sensors on th 1-Wire bus. If number of
            sensors on the bus more than this value found on the bus, the rest
            of sensors will be ignored.
endmenu
```

## examples/ds18x20/single/main/Kconfig.projbuild
```kconfig
menu "Example configuration"
    config EXAMPLE_ONEWIRE_GPIO
        int "GPIO Number of 1-Wire bus, or DQ"
        default 4 if IDF_TARGET_ESP8266
        default 18 if IDF_TARGET_ESP32C3
        default 17 if IDF_TARGET_ESP32 || IDF_TARGET_ESP32S2 || IDF_TARGET_ESP32S3
        help
            GPIO Number of 1-Wire bus, or DQ. You might need an external
            pullup resistor on the bus. See README.md for details.

    config EXAMPLE_DS18X20_ADDR
        hex "Address of the sensor"
        default "27041685c771ff28"
        help
            The address of the sensor. Change this to the address of your own
            sensor. You can find out the address of your sensor by running
            ds18x20_multi example.
endmenu
```

## examples/ds2438/main/Kconfig.projbuild
```kconfig
menu "Example configuration"
    config EXAMPLE_DS2438_ONEWIRE_PIN
        int "onewire GPIO Number"
        default 5 if IDF_TARGET_ESP8266
        default 6 if IDF_TARGET_ESP32C3
        default 25 if IDF_TARGET_ESP32 || IDF_TARGET_ESP32S2 || IDF_TARGET_ESP32S3
        help
            GPIO number for one wire.
endmenu
```

## examples/ds3502/default/main/Kconfig.projbuild
```kconfig
menu "Example configuration"
    choice EXAMPLE_I2C_ADDRESS
        prompt "Select I2C address"
        default EXAMPLE_DS3502_ADDR_0
        help
            Select I2C address

        config EXAMPLE_DS3502_ADDR_0
            bool "DS3502_ADDR_0 (0x28)"
        config EXAMPLE_DS3502_ADDR_1
            bool "DS3502_ADDR_0 (0x29)"
        config EXAMPLE_DS3502_ADDR_2
            bool "DS3502_ADDR_0 (0x2a)"
        config EXAMPLE_DS3502_ADDR_3
            bool "DS3502_ADDR_0 (0x2b)"
    endchoice

    rsource "../../../../devtools/Kconfig.i2c"
endmenu
```

## examples/example/test/sdkconfig.defaults
```kconfig
# required as the unit test application waits in busy-loop.
CONFIG_ESP_TASK_WDT=n
```

## examples/hd44780/i2c/main/Kconfig.projbuild
```kconfig
menu "Example configuration"
    config EXAMPLE_I2C_ADDR
        hex "I2C address of PCF8574"
        default 0x27

    rsource "../../../../devtools/Kconfig.i2c"
endmenu
```

## examples/hd44780/simplest_barometer/main/Kconfig.projbuild
```kconfig
menu "Example configuration"
    config EXAMPLE_I2C_PCF8574_ADDRESS
        hex "I2C address of PCF8574"
        default 0x27
        help
        I2C address of PCF8574.

    rsource "../../../../devtools/Kconfig.i2c"
endmenu
```

## examples/hdc1000/default/main/Kconfig.projbuild
```kconfig
menu "Example configuration"

    config EXAMPLE_I2C_ADDR
        hex "I2C address of HDC1000"
        default 0x40
        help
            I2C address of HDC1000. The default is `HDC1000_I2C_ADDRESS_0`, or
            0x40. See available options in hdc1000.h.

    rsource "../../../../devtools/Kconfig.i2c"
endmenu
```

## examples/ht16k33/default/main/Kconfig.projbuild
```kconfig
menu "Example configuration"
    config EXAMPLE_I2C_FREQUENCY_HZ
        int "I2C bus frequency"
        default 400000
        help
            I2C bus frequency.

    rsource "../../../../devtools/Kconfig.i2c"
endmenu
```

## examples/hx711/default/main/Kconfig.projbuild
```kconfig
menu "Example configuration"

    config EXAMPLE_PD_SCK_GPIO
        int "PD/SCK GPIO number"
        default 4 if IDF_TARGET_ESP8266
        default 4 if IDF_TARGET_ESP32C2 || IDF_TARGET_ESP32C3 || IDF_TARGET_ESP32C5 || IDF_TARGET_ESP32C6 || IDF_TARGET_ESP32C61
        default 4 if IDF_TARGET_ESP32H2
        default 4 if IDF_TARGET_ESP32P4
        default 18 if IDF_TARGET_ESP32 || IDF_TARGET_ESP32S2 || IDF_TARGET_ESP32S3
        help
            GPIO number connected to PD/SCK pin

    config EXAMPLE_DOUT_GPIO
        int "DOUT GPIO number"
        default 5 if IDF_TARGET_ESP8266 || IDF_TARGET_ESP32C3
        default 5 if IDF_TARGET_ESP32C2 || IDF_TARGET_ESP32C3 || IDF_TARGET_ESP32C5 || IDF_TARGET_ESP32C6 || IDF_TARGET_ESP32C61
        default 5 if IDF_TARGET_ESP32H2
        default 5 if IDF_TARGET_ESP32P4
        default 19 if IDF_TARGET_ESP32 || IDF_TARGET_ESP32S2 || IDF_TARGET_ESP32S3
        help
            GPIO number connected to DOUT pin

    config EXAMPLE_AVG_TIMES
        int "Samples to average"
        default 5
endmenu
```

## examples/i2cdev/default/main/Kconfig.projbuild
```kconfig
menu "I2C scanner configuration"
    config EXAMPLE_I2C_CLOCK_HZ
        int "I2C clock frequency, Hz"
        default 100000

    rsource "../../../../devtools/Kconfig.i2c"
endmenu
```

## examples/icm42670/default/main/Kconfig.projbuild
```kconfig
menu "Example configuration"
    choice EXAMPLE_I2C_ADDRESS
        prompt "Select I2C address"
        default EXAMPLE_I2C_ADDRESS_GND
        help
            Select I2C address.

        config EXAMPLE_I2C_ADDRESS_GND
            bool "ICM42670_I2C_ADDR_GND (0x68)"
        config EXAMPLE_I2C_ADDRESS_VCC
            bool "ICM42670_I2C_ADDR_VCC (0x69)"
    endchoice

    config EXAMPLE_INT_INPUT_PIN
        int "Interrupt Input Pin GPIO Number"
        default 0
        help
            GPIO number for Interrupt Input Pin

    rsource "../../../../devtools/Kconfig.i2c"
endmenu
```

## examples/icm42670/wake-on-motion/main/Kconfig.projbuild
```kconfig
menu "Example configuration"
    choice EXAMPLE_I2C_ADDRESS
        prompt "Select I2C address"
        default EXAMPLE_I2C_ADDRESS_GND
        help
            Select I2C address.

        config EXAMPLE_I2C_ADDRESS_GND
            bool "ICM42670_I2C_ADDR_GND (0x68)"
        config EXAMPLE_I2C_ADDRESS_VCC
            bool "ICM42670_I2C_ADDR_VCC (0x69)"
    endchoice

    config EXAMPLE_I2C_MASTER_SCL
        int "SCL GPIO Number"
        default 5 if IDF_TARGET_ESP8266
        default 6 if IDF_TARGET_ESP32C3
        default 19 if IDF_TARGET_ESP32 || IDF_TARGET_ESP32S2 || IDF_TARGET_ESP32S3
        help
            GPIO number for I2C Master clock line.

    config EXAMPLE_I2C_MASTER_SDA
        int "SDA GPIO Number"
        default 4 if IDF_TARGET_ESP8266
        default 5 if IDF_TARGET_ESP32C3
        default 18 if IDF_TARGET_ESP32 || IDF_TARGET_ESP32S2 || IDF_TARGET_ESP32S3
        help
            GPIO number for I2C Master data line.

    config EXAMPLE_INT_INPUT_PIN
        int "Interrupt Input Pin GPIO Number"
        default 0
        help
            GPIO number for Interrupt Input Pin

endmenu
```

## examples/impulse_sensor/default/main/Kconfig.projbuild
```kconfig
menu "Example configuration"
    config EXAMPLE_DATA_GPIO
        int "DATA GPIO Number"
        default 2 if IDF_TARGET_ESP8266
        default 6 if IDF_TARGET_ESP32C2 || IDF_TARGET_ESP32C3 || IDF_TARGET_ESP32C5 || IDF_TARGET_ESP32C6 || IDF_TARGET_ESP32C61
        default 19 if IDF_TARGET_ESP32 || IDF_TARGET_ESP32S2 || IDF_TARGET_ESP32S3
        default 6 if IDF_TARGET_ESP32H2
        help
            GPIO number for anemometer sensor DATA line.

endmenu
```

## examples/ina219/default/main/Kconfig.projbuild
```kconfig
menu "Example configuration"
    config EXAMPLE_SHUNT_RESISTOR_MILLI_OHM
        int "Shunt resistor value in milliohm)"
        default 100
        help
            Shunt resistor value in milliohm. Must not be zero.

    config EXAMPLE_I2C_ADDR
        hex "I2C address of INA219"
        default 0x40
        help
            I2C address of INA219. The default is A1 pin to GND, and A0 pin to
            GND (`INA219_ADDR_GND_GND`, or `0x40`). See available options in
            ina219.h.

    rsource "../../../../devtools/Kconfig.i2c"
endmenu
```

## examples/ina260/default/main/Kconfig.projbuild
```kconfig
menu "Example configuration"
    config EXAMPLE_I2C_ADDR
        hex "I2C address of INA260"
        default 0x40
        help
            I2C address of INA260. The address starts from `0x40`, which is
            the default (`A0` and `A1` are grounded), and ends at `0x4f` (16
            possible addresses). See "8.5.3.1 Serial Bus Address" in the
            datasheet. ina260.h provides a uitility macro for the address
            (INA260_ADDR()).

    rsource "../../../../devtools/Kconfig.i2c"
endmenu
```

## examples/ina3221/default/main/Kconfig.projbuild
```kconfig
menu "Example configuration"
    config EXAMPLE_SHUNT_RESISTOR_MILLI_OHM
        int "Shunt resistor value in milliohms"
        default 100

    config EXAMPLE_I2C_ADDR
        hex "I2C address of INA3221"
        default 0x40
        help
            I2C address of INA3221. The default is `INA3221_I2C_ADDR_GND`, or
            0x40. See available options in ina3221.h.

    choice EXAMPLE_MEASURING_MODE
        prompt "Select measuring mode"
        default EXAMPLE_MEASURING_MODE_TRIGGER
        config EXAMPLE_MEASURING_MODE_TRIGGER
            bool "Trigger measurements"
            help
                Measuring mode to use. See 8.3.1 Basic ADC Functions in the datasheet.
        config EXAMPLE_MEASURING_MODE_CONTINUOUS
            bool "Continuous  measurements"
            help
                Measuring mode to use. See 8.3.1 Basic ADC Functions in the datasheet.
    endchoice

    rsource "../../../../devtools/Kconfig.i2c"
endmenu
```

## examples/ina3221/main/Kconfig.projbuild
```kconfig
menu "Example configuration"
    config EXAMPLE_SHUNT_RESISTOR_MILLI_OHM
        int "Shunt resistor value in milliohms"
        default 100

    config EXAMPLE_I2C_ADDR
        hex "I2C address of INA3221"
        default 0x40
        help
            I2C address of INA3221. The default is `INA3221_I2C_ADDR_GND`, or
            0x40. See available options in ina3221.h.

    choice EXAMPLE_MEASURING_MODE
        prompt "Select measuring mode"
        default EXAMPLE_MEASURING_MODE_TRIGGER
        config EXAMPLE_MEASURING_MODE_TRIGGER
            bool "Trigger measurements"
            help
                Measuring mode to use. See 8.3.1 Basic ADC Functions in the datasheet.
        config EXAMPLE_MEASURING_MODE_CONTINUOUS
            bool "Continuous  measurements"
            help
                Measuring mode to use. See 8.3.1 Basic ADC Functions in the datasheet.
    endchoice

    config EXAMPLE_I2C_MASTER_SCL
        int "SCL GPIO Number"
        default 5 if IDF_TARGET_ESP8266
        default 6 if IDF_TARGET_ESP32C3
        default 19 if IDF_TARGET_ESP32 || IDF_TARGET_ESP32S2 || IDF_TARGET_ESP32S3
        help
            GPIO number for I2C Master clock line.

    config EXAMPLE_I2C_MASTER_SDA
        int "SDA GPIO Number"
        default 4 if IDF_TARGET_ESP8266
        default 5 if IDF_TARGET_ESP32C3
        default 18 if IDF_TARGET_ESP32 || IDF_TARGET_ESP32S2 || IDF_TARGET_ESP32S3
        help
            GPIO number for I2C Master data line.
endmenu
```
