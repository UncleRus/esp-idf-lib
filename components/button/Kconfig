## components/button/Kconfig
```kconfig
menu "Button"

	config BUTTON_MAX
		int "Maximum number of buttons"
		range 1 10
		default 5
	
	config BUTTON_POLL_TIMEOUT
		int "Poll timeout, ms"
		range 1 1000
		default 10

	config BUTTON_LONG_PRESS_TIMEOUT
		int "Timeout of long press, ms"
		range 100 10000
		default 1000

	config BUTTON_AUTOREPEAT_TIMEOUT
		int "Timeout before autorepeat, ms"
		range 100 10000
		default 500

	config BUTTON_AUTOREPEAT_INTERVAL
		int "Autorepeat interval, ms"
		range 100 10000
		default 250
		
endmenu
```

## components/dps310/Kconfig
```kconfig
menu "DPS310 driver"
    choice DPS310_PROTOCOL
        prompt "Choose protocol for digital interface"
        default DPS310_PROTOCOL_USING_I2C
        help
            The protocol to use for digital interface
        config DPS310_PROTOCOL_USING_I2C
            bool "I2C"
    endchoice
endmenu
```

## components/encoder/Kconfig
```kconfig
menu "Rotary encoders"

	config RE_MAX
		int "Maximum number of rotary encoders"
		default 1
			
	config RE_INTERVAL_US
		int "Polling interval, us"
		default 10000 if IDF_TARGET_ESP8266
		default 1000 if !IDF_TARGET_ESP8266
		
	config RE_BTN_DEAD_TIME_US
		int "Button dead time, us"
		default 10000
			
	choice RE_BTN_PRESSED_LEVEL
		prompt "Logical level on pressed button"
		config RE_BTN_PRESSED_LEVEL_0
			bool "0"
		config RE_BTN_PRESSED_LEVEL_1
			bool "1"
	endchoice
	
	config RE_BTN_LONG_PRESS_TIME_US
		int "Long press timeout, us"
		default 500000

	config RE_ACCELERATION_MIN_CUTOFF
		int "Minimum Acceleration cutoff time (ms)"
		default 200
		help
            At this time in milliseconds between rotary ticks we want to be at the minimum acceleration

	config RE_ACCELERATION_MAX_CUTOFF
		int "Maximum Acceleration cutoff time (ms)"
		default 4
		help
            At this time in milliseconds between rotary ticks we want to be at the maximum acceleration
endmenu
```

## components/example/Kconfig
```kconfig
menu "Example"
    choice EXAMPLE_CHOOSE
        prompt "Choose one"
        default EXAMPLE_USING_FOO
        help
            An example to choose one from choices
        config EXAMPLE_USING_FOO
            bool "FOO"
        config EXAMPLE_USING_BAR
            bool "BAR"
    endchoice
    config EXAMPLE_NUMBER
        int "Number example"
        default 1
        help
            An example to choose number
endmenu
```

## components/hmc5883l/Kconfig
```kconfig
menu "HMC5883L"

config HMC5883L_MEAS_TIMEOUT
    int "Measurement timeout, microseconds"
    default 6000
    range 500 10000

endmenu
```

## components/i2c_utils/Kconfig
```kconfig
menu "I2C"

config I2C_TIMEOUT
    int "I2C transaction timeout, milliseconds"
    default 1000
    range 100 5000
    
endmenu
```

## components/i2cdev/Kconfig
```kconfig
menu "I2C Device Library"

config I2CDEV_USE_LEGACY_DRIVER
	bool "Use Legacy I2C Driver API"
	default n
	help
		Select this option to use the older ESP-IDF I2C driver API (driver/i2c.h)
		instead of the newer driver API (driver/i2c_master.h).
		
		This is automatically determined by the build system based on your ESP-IDF version.
		For ESP-IDF versions prior to v5.3, the legacy driver will be used automatically.
		You can manually override this setting if needed.

config I2CDEV_AUTO_ENABLE_PULLUPS
	bool "Automatically enable internal I2C pullups when not configured"
	default n
	depends on !IDF_TARGET_ESP8266
	help
		When enabled, internal pullup resistors are automatically enabled
		when both sda_pullup_en and scl_pullup_en are false (default state).
		
		Useful for development and prototyping. Disable for production 
		systems with external pullups to avoid interference.
		
		Considerations:
		- May increase power consumption slightly
		- Could interfere with carefully tuned external pullups
		- Not recommended for battery-powered applications
		
		Note: This option only affects the modern i2cdev driver (ESP32 family).
		Legacy driver behavior is unchanged for compatibility.

config I2CDEV_DEFAULT_SDA_PIN
	int "Default I2C SDA pin"
	default 21
	help
		Default SDA pin for I2C devices.

config I2CDEV_DEFAULT_SCL_PIN
	int "Default I2C SCL pin"
	default 22
	help
		Default SCL pin for I2C devices.

config I2CDEV_MAX_DEVICES_PER_PORT
	int "Maximum number of devices per I2C port"
	default 8
	help
		Maximum number of devices that can be registered on a single I2C port.

config I2CDEV_TIMEOUT
    int "I2C transaction timeout, milliseconds"
    default 1000
    range 10 5000
    
config I2CDEV_NOLOCK
	bool "Disable the use of mutexes"
	default n
	help
		Attention! After enabling this option, all I2C device
		drivers will become non-thread safe. 
		Use this option if you need to access your I2C devices
		from interrupt handlers. 

endmenu
```

## components/led_effect/Kconfig
```kconfig
menu "LED effect"
    choice LED_EFFECT_COLOR
        prompt "Choose RGB or RGBW"
        default LED_EFFECT_COLOR_USING_RGB
        help
            Choose whethert if LED has white LED
        config LED_EFFECT_COLOR_USING_RGB
            bool "RGB"
        config LED_EFFECT_COLOR_USING_RGBW
            bool "RGBW"
    endchoice
endmenu
```

## components/led_strip/Kconfig
```kconfig
menu "LED strip"

config LED_STRIP_FLUSH_TIMEOUT
    int "Strip flush timeout, ms"
    default 1000

config LED_STRIP_PAUSE_LENGTH
	int "Delay between flushes, us"
	default 50
	help
		This delay is between the sending full data to the all LEDs in strip.
		Without this delay, a bug with "missing" pixels is possible: 
		if delay between calls to led_strip_flush() is small, the LEDs consider
		the new data package sent to all LEDs in strip to be a continuation of
		the previous one.
    
endmenu
```

## components/led_strip_spi/Kconfig
```kconfig
menu "LED strip SPI"
    choice LED_STRIP_SPI_PROTOCOL_CHOOSE
        prompt "Choose protocol for SPI"
        default LED_STRIP_SPI_USING_SK9822
        help
            The protocol to use SPI communication.
        config LED_STRIP_SPI_USING_SK9822
            bool "SK9822 (and APA102)"
    endchoice
    config LED_STRIP_SPI_MUTEX_TIMEOUT_MS
        int "Timeout in msec to obtain mutex"
        default 1
        help
            Timeout when obtaining mutex with xSemaphoreTake.
endmenu
```

## components/max1704x/Kconfig
```kconfig
menu "MAX1704X Battery Fuel Gauge"

    choice MAX1704X_MODEL
        prompt "Chip type"
        config MAX1704X_MODEL_3_4
            bool "MAX17043/MAX17044"
        config MAX1704X_MODEL_8_9
            bool "MAX17048/MAX17049"
    endchoice
    
endmenu
```

## components/mcp23x17/Kconfig
```kconfig
menu "MCP23x17"

	choice MCP23X17_IFACE
		prompt "Chip type"
		config MCP23X17_IFACE_I2C
			bool "MCP23017 [I2C]"
		config MCP23X17_IFACE_SPI
			bool "MCP23S17 [SPI]"
	endchoice

endmenu
```

## components/mpu6050/Kconfig
```kconfig
menu "MPU6050"

config AUTO_CONFIG_ADDR
    bool "configure mpu6050 addr at run time"
    default false
    
endmenu
```

## components/onewire/Kconfig
```kconfig
menu "OneWire"

config ONEWIRE_CRC8_TABLE
    bool "Fast CRC-8 algorithm"
    default "y"
    help
        Compute a Dallas Semiconductor 8 bit CRC using a CRC table located in flash

endmenu
```

## components/ssd1306/Kconfig
```kconfig
menu "SSD1306 display driver"

    choice SSD1306_PROTOCOL_CHOOSE
        prompt "Choose protocol for SSD1306"
        default SSD1306_PROTOCOL_I2C

        config SSD1306_PROTOCOL_I2C
            bool "I2C"

        config SSD1306_PROTOCOL_SPI3
            bool "3-wire SPI"

        config SSD1306_PROTOCOL_SPI4
            bool "4-wire SPI (SPI + D/C)"
    endchoice

endmenu
```

## components/utils/Kconfig
```kconfig
menu "ESP-NOW Utils Configuration"
    choice MEM_ALLOCATION_LOCATION
        prompt "The memory location allocated by MALLOC CALLOC and REALLOC"
        help 
            choice where to allocate memory, can be SPIRAM or default

        config MEM_ALLOCATION_DEFAULT
            bool "default allocation strategy"
        config MEM_ALLOCATION_SPIRAM
            depends on ESP32S2_SPIRAM_SUPPORT || ESP32_SPIRAM_SUPPORT
            bool "allocate memory in SPIRAM"
    endchoice
        
endmenu
```

## devtools/Kconfig.i2c
```kconfig
config EXAMPLE_I2C_MASTER_SCL
    int "SCL GPIO Number"
    default 5 if IDF_TARGET_ESP8266
    default 6 if IDF_TARGET_ESP32C2 || IDF_TARGET_ESP32C3 || IDF_TARGET_ESP32C5 || IDF_TARGET_ESP32C6 || IDF_TARGET_ESP32C61
    default 19 if IDF_TARGET_ESP32 || IDF_TARGET_ESP32S2 || IDF_TARGET_ESP32S3
    default 4 if IDF_TARGET_ESP32H2
    default 4 if IDF_TARGET_ESP32P4
    help
        GPIO number for I2C Master clock line.

config EXAMPLE_I2C_MASTER_SDA
    int "SDA GPIO Number"
    default 4 if IDF_TARGET_ESP8266
    default 5 if IDF_TARGET_ESP32C2 || IDF_TARGET_ESP32C3 || IDF_TARGET_ESP32C5 || IDF_TARGET_ESP32C6 || IDF_TARGET_ESP32C61
    default 18 if IDF_TARGET_ESP32 || IDF_TARGET_ESP32S2 || IDF_TARGET_ESP32S3
    default 3 if IDF_TARGET_ESP32H2
    default 3 if IDF_TARGET_ESP32P4
    help
        GPIO number for I2C Master data line.
```

## examples/ads1115/main/Kconfig.projbuild
```kconfig
menu "Example configuration"
    config EXAMPLE_DEV_COUNT
        int "Number of ADS111x"
        default 2
        help
            Number of ADS111x devices on the bus.

    config EXAMPLE_I2C_MASTER_SCL
        int "SCL GPIO Number"
        default 5 if IDF_TARGET_ESP8266
        default 6 if IDF_TARGET_ESP32C3
        default 19 if IDF_TARGET_ESP32 || IDF_TARGET_ESP32S2 || IDF_TARGET_ESP32S3
        help
            GPIO number for I2C Master clock line.

    config EXAMPLE_I2C_MASTER_SDA
        int "SDA GPIO Number"
        default 4 if IDF_TARGET_ESP8266
        default 5 if IDF_TARGET_ESP32C3
        default 18 if IDF_TARGET_ESP32 || IDF_TARGET_ESP32S2 || IDF_TARGET_ESP32S3
        help
            GPIO number for I2C Master data line.
endmenu
```

## examples/ads111x/default/main/Kconfig.projbuild
```kconfig
menu "Example configuration"
    config EXAMPLE_DEV_COUNT
        int "Number of ADS111x"
        default 2
        help
            Number of ADS111x devices on the bus.

    rsource "../../../../devtools/Kconfig.i2c"
endmenu
```

## examples/ads130e08/default/main/Kconfig.projbuild
```kconfig
menu "Example configuration"
    config EXAMPLE_MOSI_GPIO
        int "SPI MOSI GPIO Number"
        default 4 if IDF_TARGET_ESP32C2 || IDF_TARGET_ESP32C3 || IDF_TARGET_ESP32C5 || IDF_TARGET_ESP32C6 || IDF_TARGET_ESP32C61
        default 4 if IDF_TARGET_ESP32H2
        default 4 if IDF_TARGET_ESP32P4
        default 23 if IDF_TARGET_ESP32
        default 11 if IDF_TARGET_ESP32S2 || IDF_TARGET_ESP32S3
        help
            GPIO number for SPI MOSI (Master Output / Slave Input) line.

    config EXAMPLE_MISO_GPIO
        int "SPI MISO GPIO Number"
        default 5 if IDF_TARGET_ESP32C2 || IDF_TARGET_ESP32C3 || IDF_TARGET_ESP32C5 || IDF_TARGET_ESP32C6 || IDF_TARGET_ESP32C61
        default 5 if IDF_TARGET_ESP32H2
        default 5 if IDF_TARGET_ESP32P4
        default 19 if IDF_TARGET_ESP32
        default 13 if IDF_TARGET_ESP32S2 || IDF_TARGET_ESP32S3
        help
            GPIO number for SPI MISO (Master Input / Slave Output) line.

    config EXAMPLE_SCLK_GPIO
        int "SPI SCLK GPIO Number"
        default 6 if IDF_TARGET_ESP32C2 || IDF_TARGET_ESP32C3 || IDF_TARGET_ESP32C5 || IDF_TARGET_ESP32C6 || IDF_TARGET_ESP32C61
        default 6 if IDF_TARGET_ESP32H2
        default 6 if IDF_TARGET_ESP32P4
        default 18 if IDF_TARGET_ESP32
        default 12 if IDF_TARGET_ESP32S2 || IDF_TARGET_ESP32S3
        help
            GPIO number for SPI SCLK (Clock) line.

    config EXAMPLE_CS_GPIO
        int "SPI CS GPIO Number"
        default 7 if IDF_TARGET_ESP32C2 || IDF_TARGET_ESP32C3 || IDF_TARGET_ESP32C5 || IDF_TARGET_ESP32C6 || IDF_TARGET_ESP32C61
        default 7 if IDF_TARGET_ESP32H2
        default 7 if IDF_TARGET_ESP32P4
        default 6 if IDF_TARGET_ESP32
        default 10 if IDF_TARGET_ESP32S2 || IDF_TARGET_ESP32S3
        help
            GPIO number for SPI CS (Chip Select) line.

    config EXAMPLE_INT_GPIO
        int "SPI INT GPIO Number"
        default 8 if IDF_TARGET_ESP32C2 || IDF_TARGET_ESP32C3 || IDF_TARGET_ESP32C5 || IDF_TARGET_ESP32C6 || IDF_TARGET_ESP32C61
        default 8 if IDF_TARGET_ESP32H2
        default 8 if IDF_TARGET_ESP32P4
        default 26 if IDF_TARGET_ESP32
        default 2 if IDF_TARGET_ESP32S2 || IDF_TARGET_ESP32S3
        help
            GPIO number for SPI INT (Interrupt) line.
endmenu
```

## examples/aht/default/main/Kconfig.projbuild
```kconfig
menu "Example configuration"
    choice EXAMPLE_I2C_ADDRESS
        prompt "Select I2C address"
        default EXAMPLE_I2C_ADDRESS_GND
        help
            Select I2C address

        config EXAMPLE_I2C_ADDRESS_GND
            bool "AHT_I2C_ADDRESS_GND"
            help
                Choose this when ADDR pin is connected to ground
        config EXAMPLE_I2C_ADDRESS_VCC
            bool "AHT_I2C_ADDRESS_VCC"
            help
                Choose this when ADDR pin is connected to VCC
    endchoice

    choice EXAMPLE_CHIP_TYPE
        prompt "Select chip type"
        default EXAMPLE_TYPE_AHT1x
        help
            Select AHT chip type

        config EXAMPLE_TYPE_AHT1x
            bool "AHT10 or AHT15"
        config EXAMPLE_TYPE_AHT20
            bool "AHT20"
    endchoice

    rsource "../../../../devtools/Kconfig.i2c"
endmenu
```

## examples/bh1750/default/main/Kconfig.projbuild
```kconfig
menu "Example configuration"
    choice EXAMPLE_I2C_ADDRESS
        prompt "Select I2C address"
        default EXAMPLE_I2C_ADDRESS_LO
        help
            Select I2C address

        config EXAMPLE_I2C_ADDRESS_LO
            bool "BH1750_ADDR_LO"
            help
                Choose this when ADDR pin is floating or low.
        config EXAMPLE_I2C_ADDRESS_HI
            bool "BH1750_ADDR_HI"
            help
                Choose this when ADDR pin is high.
    endchoice

    rsource "../../../../devtools/Kconfig.i2c"
endmenu
```

## examples/bh1900nux/default/main/Kconfig.projbuild
```kconfig
menu "Example configuration"

    config EXAMPLE_I2C_ADDR
        hex "I2C address of BH1900NUX"
        default 0x48
        help
            I2C address of BH1900NUX. The default is `BH1900NUX_I2C_ADDR_BASE`, or
            0x48. See available options in datasheet.

    choice EXAMPLE_MEASURING_MODE
        prompt "Select measuring mode"
        default EXAMPLE_MEASURING_MODE_TRIGGER
        config EXAMPLE_MEASURING_MODE_TRIGGER
            bool "Trigger measurements"
        config EXAMPLE_MEASURING_MODE_CONTINUOUS
            bool "Continuous  measurements"
    endchoice

    rsource "../../../../devtools/Kconfig.i2c"
endmenu
```

## examples/bme680/default/main/Kconfig.projbuild
```kconfig
menu "Example configuration"
    choice EXAMPLE_I2C_ADDRESS
        prompt "Select I2C address"
        default EXAMPLE_I2C_ADDRESS_0
        help
            Select I2C address.

        config EXAMPLE_I2C_ADDRESS_0
            bool "BME680_I2C_ADDR_0 (0x76)"
        config EXAMPLE_I2C_ADDRESS_1
            bool "BME680_I2C_ADDR_1 (0x77)"
    endchoice

    rsource "../../../../devtools/Kconfig.i2c"
endmenu
```
